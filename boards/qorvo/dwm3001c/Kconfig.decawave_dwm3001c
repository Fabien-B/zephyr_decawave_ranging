## boards/qorvo/dwm3001c/Kconfig.decawave_dwm3001c
```kconfig
# DecaWave DWM3001C board configuration

# Copyright (c) 2019 Stéphane D'Alu
# SPDX-License-Identifier: Apache-2.0

config BOARD_DECAWAVE_DWM3001C
	select SOC_NRF52833_QDAA
```

## boards/qorvo/dwm3001c/Kconfig.defconfig
```kconfig
# DecaWave DWM3001C board configuration

# Copyright (c) 2019 Stéphane D'Alu
# SPDX-License-Identifier: Apache-2.0

if BOARD_DECAWAVE_DWM3001C

config I2C
	default SENSOR

endif # BOARD_DECAWAVE_DWM3001C
```

## boards/qorvo/dwm3001c/board.yml
```yaml
board:
  name: decawave_dwm3001c
  full_name: Decawave DWM3001C
  vendor: qorvo
  socs:
  - name: nrf52833
```
